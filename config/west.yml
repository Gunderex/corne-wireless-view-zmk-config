## config/west.yml
```yaml
manifest:
  remotes:
    - name: zmkfirmware
      url-base: https://github.com/zmkfirmware
    - name: dsifry
      url-base: https://github.com/dsifry
    - name: m165437 #new entry
      url-base: https://github.com/M165437 #new entry
  projects:
    - name: zmk
      remote: zmkfirmware
      revision: main
      import: app/west.yml
    - name: nice-view-mod #new entry
      remote: dsifry #new entry
      revision: main #new entry
    - name: nice-view-gem #new entry
      remote: m165437 #new entry
      revision: main #new entry
  self:
    path: config
```
